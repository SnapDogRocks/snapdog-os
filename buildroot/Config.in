## buildroot/Config.in
```kconfig
comment "SnapDog OS"
source "$BR2_EXTERNAL_SNAPDOG_PATH/package/snapdog-os-all/Config.in"

comment "Base packages"
source "$BR2_EXTERNAL_SNAPDOG_PATH/package/snapdog-base/Config.in"
source "$BR2_EXTERNAL_SNAPDOG_PATH/package/snapdog-users/Config.in"
source "$BR2_EXTERNAL_SNAPDOG_PATH/package/snapdog-tools/Config.in"
source "$BR2_EXTERNAL_SNAPDOG_PATH/package/copy-overlays/Config.in"
source "$BR2_EXTERNAL_SNAPDOG_PATH/package/configtxt/Config.in"
source "$BR2_EXTERNAL_SNAPDOG_PATH/package/raspi-wifi/Config.in"

comment "Audio"
source "$BR2_EXTERNAL_SNAPDOG_PATH/package/snapdog-client/Config.in"
source "$BR2_EXTERNAL_SNAPDOG_PATH/package/snapdog-server/Config.in"

comment "System"
source "$BR2_EXTERNAL_SNAPDOG_PATH/package/snapdog-ctrl/Config.in"
source "$BR2_EXTERNAL_SNAPDOG_PATH/package/snapdog-rauc/Config.in"
```

## buildroot/package/raspi-wifi/Config.in
```kconfig
config BR2_PACKAGE_RASPI_WIFI
	bool "raspi-wifi"
	help
	  WiFi support with temporary AP for initial setup.

	# Temp-AP (DHCP server + captive DNS are handled by systemd-networkd and
	# snapdog-ctrl respectively; only hostapd is needed for the radio)
	select BR2_PACKAGE_HOSTAPD
	select BR2_PACKAGE_HOSTAPD_DRIVER_NL80211
	select BR2_PACKAGE_HOSTAPD_HAS_WIFI_DRIVERS
	select BR2_PACKAGE_HOSTAPD_ACS

	# WPA supplicant (client)
	select BR2_PACKAGE_WPA_SUPPLICANT
	select BR2_PACKAGE_WPA_SUPPLICANT_NL80211
	select BR2_PACKAGE_WPA_SUPPLICANT_AP_SUPPORT
	select BR2_PACKAGE_WPA_SUPPLICANT_AUTOSCAN
	select BR2_PACKAGE_WPA_SUPPLICANT_HOTSPOT
	select BR2_PACKAGE_WPA_SUPPLICANT_DEBUG_SYSLOG
	select BR2_PACKAGE_WPA_SUPPLICANT_CLI
	select BR2_PACKAGE_WPA_SUPPLICANT_PASSPHRASE
	select BR2_PACKAGE_WPA_SUPPLICANT_DBUS
	select BR2_PACKAGE_WPA_SUPPLICANT_WPA3

	# Firmware
	select BR2_PACKAGE_BRCMFMAC_SDIO_FIRMWARE_RPI
	select BR2_PACKAGE_BRCMFMAC_SDIO_FIRMWARE_RPI_WIFI
```

## buildroot/package/snapdog-base/Config.in
```kconfig
config BR2_PACKAGE_SNAPDOG_BASE
	bool "snapdog-base"
	help
	  Base prerequisites for SnapDog OS.
	select BR2_PACKAGE_ALSA_LIB
	select BR2_PACKAGE_ALSA_UTILS
	select BR2_PACKAGE_ALSA_UTILS_ALSACTL
	select BR2_PACKAGE_ALSA_UTILS_APLAY
	select BR2_PACKAGE_AVAHI
	select BR2_PACKAGE_AVAHI_DAEMON
	select BR2_PACKAGE_AVAHI_LIBDNSSD_COMPATIBILITY
	select BR2_USE_MMU
```

## buildroot/package/snapdog-os-all/Config.in
```kconfig
config BR2_PACKAGE_SNAPDOG_OS_ALL
	bool "snapdog-os-all"
	help
	  Select all packages required for SnapDog OS.
	select BR2_PACKAGE_OPENSSH
	select BR2_PACKAGE_SNAPDOG_BASE
	select BR2_PACKAGE_SNAPDOG_USERS
	select BR2_PACKAGE_SNAPDOG_TOOLS
	select BR2_PACKAGE_COPY_OVERLAYS if BR2_PACKAGE_RPI_FIRMWARE
	select BR2_PACKAGE_CONFIGTXT if BR2_PACKAGE_RPI_FIRMWARE
	select BR2_PACKAGE_CONFIGTXT_QUIET if BR2_PACKAGE_RPI_FIRMWARE
	# NOTE: BR2_PACKAGE_CONFIGTXT_EEPROM is intentionally NOT selected. It writes
	# force_eeprom_read=0, which disables the firmware's boot-time HAT ID EEPROM
	# read — so /proc/device-tree/hat is never populated and DAC auto-detection
	# (snapdog-ctrl detect_hat_overlay) can never identify a HAT (e.g. HiFiBerry
	# Amp100). Leaving it unset keeps the RPi default (force_eeprom_read=1) so HATs
	# with an EEPROM are detected. Enable it only for boards that lack an EEPROM.
	select BR2_PACKAGE_RASPI_WIFI if BR2_PACKAGE_RPI_FIRMWARE
	select BR2_PACKAGE_SNAPDOG_CLIENT
	select BR2_PACKAGE_SNAPDOG_SERVER
	select BR2_PACKAGE_SNAPDOG_RAUC
	select BR2_PACKAGE_SNAPDOG_CTRL
```

## buildroot/package/snapdog-rauc/Config.in
```kconfig
config BR2_PACKAGE_SNAPDOG_RAUC
	bool "snapdog-rauc"
	help
	  RAUC configuration for SnapDog OS (system.conf, boot handler, keyring).
	select BR2_PACKAGE_RAUC
```

## buildroot/package/snapdog-server/Config.in
```kconfig
config BR2_PACKAGE_SNAPDOG_SERVER
	bool "snapdog-server"
	help
	  SnapDog multiroom audio server.
	  https://github.com/metaneutrons/snapdog
	depends on BR2_PACKAGE_ALSA_LIB
	select BR2_PACKAGE_AVAHI
	select BR2_PACKAGE_AVAHI_DAEMON
	select BR2_PACKAGE_AVAHI_LIBDNSSD_COMPATIBILITY
	select BR2_PACKAGE_DBUS
```

## buildroot/package/snapdog-tools/Config.in
```kconfig
config BR2_PACKAGE_SNAPDOG_TOOLS
	bool "snapdog-tools"
	help
	  Boot-time system tools for SnapDog OS.
	depends on BR2_PACKAGE_SNAPDOG_BASE
	depends on BR2_INIT_SYSTEMD
	select BR2_PACKAGE_E2FSPROGS
	select BR2_PACKAGE_PARTED
	select BR2_PACKAGE_RNG_TOOLS
	select BR2_PACKAGE_UTIL_LINUX
	select BR2_PACKAGE_UTIL_LINUX_BINARIES
```

## buildroot/package/snapdog-updater/Config.in
```kconfig
config BR2_PACKAGE_SNAPDOG_UPDATER
	bool "snapdog-updater"
	help
	  OTA update tools for SnapDog OS (dual-partition A/B).
	depends on BR2_PACKAGE_RPI_FIRMWARE
	depends on BR2_PACKAGE_SNAPDOG_BASE
	select BR2_PACKAGE_E2FSPROGS
	select BR2_PACKAGE_OPENSSL
	select BR2_PACKAGE_LIBOPENSSL
	select BR2_PACKAGE_LIBOPENSSL_BIN
	select BR2_PACKAGE_LIBCURL
	select BR2_PACKAGE_LIBCURL_CURL
	select BR2_PACKAGE_PARTED
```
